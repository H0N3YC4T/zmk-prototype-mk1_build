## boards/shields/nice_oled_prototype_mk1/Kconfig.shield
```kconfig
config SHIELD_NICE_OLED_PROTOTYPE_MK1
    def_bool $(shields_list_contains,nice_oled_prototype_mk1)
```

## boards/shields/nice_view_omnisiah/Kconfig.shield
```kconfig
config SHIELD_NICE_VIEW_OMNISSIAH
    def_bool $(shields_list_contains,nice_view_omnissiah)
```

## boards/shields/prototype_mk1/Kconfig.shield
```kconfig
# Copyright (c) 2020 Ryan Cross
# SPDX-License-Identifier: MIT

config SHIELD_PROTOTYPE_MK1_LEFT
    def_bool $(shields_list_contains,prototype_mk1_left)
    #select ADC
    #select GPIO

config SHIELD_PROTOTYPE_MK1_RIGHT
    def_bool $(shields_list_contains,prototype_mk1_right)
```

## config/west.yml
```yaml
manifest:
  remotes:
    - name: H0N3YC4T
      url-base: https://github.com/H0N3YC4T
    - name: zmkfirmware
      url-base: https://github.com/zmkfirmware
  projects:
    - name: zmk-prototype_mk1
      remote: H0N3YC4T
      revision: main
      import: west.yml
    - name: zmk
      remote: zmkfirmware
      revision: main
      import: app/west.yml
  self:
    path: config
```
